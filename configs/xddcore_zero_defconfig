## configs/xddcore_zero_defconfig
```kconfig
CONFIG_ARM=y
CONFIG_ARCH_SUNXI=y
CONFIG_DEFAULT_DEVICE_TREE="suniv-f1c200s-xddcore-zero"
CONFIG_SPL=y
CONFIG_IDENT_STRING="Xddcore-Zero-Board"
CONFIG_MACH_SUNIV=y
CONFIG_DRAM_CLK=156
CONFIG_DRAM_ZQ=0
CONFIG_SUNXI_MINIMUM_DRAM_MB=64
CONFIG_USE_BOOTARGS=y
CONFIG_CONS_INDEX=1
```

## configs/xddcore_zero_overclock_defconfig
```kconfig
CONFIG_ARM=y
CONFIG_ARCH_SUNXI=y
CONFIG_DEFAULT_DEVICE_TREE="suniv-f1c200s-xddcore-zero"
CONFIG_SPL=y
CONFIG_IDENT_STRING="Xddcore-Zero-Board"
CONFIG_MACH_SUNIV=y
CONFIG_SYS_CLK_FREQ=720000000
CONFIG_DRAM_CLK=156
CONFIG_DRAM_ZQ=0
CONFIG_SUNXI_MINIMUM_DRAM_MB=64
CONFIG_USE_BOOTARGS=y
CONFIG_BOOTARGS="console=ttyS0,115200 panic=5 rootwait root=/dev/mmcblk0p2 earlyprintk rw"
CONFIG_BOOTCOMMAND="load mmc 0:1 0x80008000 zImage;load mmc 0:1 0x80c08000 suniv-f1c200s-xddcore-zero.dtb;bootz 0x80008000 - 0x80c08000;"
CONFIG_CONS_INDEX=1
```
